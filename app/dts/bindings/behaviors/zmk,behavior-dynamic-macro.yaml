## app/dts/bindings/behaviors/zmk,behavior-dynamic-macro.yaml
```yaml
# Copyright (c) 2022 The ZMK Contributors
# SPDX-License-Identifier: MIT

description: Dynamic Macro Behavior

compatible: "zmk,behavior-dynamic-macro"

include: one_param.yaml

properties:
  wait-ms:
    type: int
    default: 100
    description: The default time to wait (in milliseconds) before triggering the next behavior in the macro bindings list.
  tap-ms:
    type: int
    default: 100
    description: The default time to wait (in milliseconds) between the press and release events on a tapped macro behavior binding
```

## app/dts/bindings/behaviors/zmk,behavior-smart-interrupt.yaml
```yaml
# Copyright (c) 2022 The ZMK Contributors
# SPDX-License-Identifier: MIT

description: Smart Interrupt Behavior

compatible: "zmk,behavior-smart-interrupt"

include: zero_param.yaml

properties:
  bindings:
    type: phandle-array
    required: true
  shared-key-positions:
    type: array
    required: false
    default: []
  shared-layers:
    type: array
    required: false
    default: []
```

## app/west.yml
```yaml
manifest:
  remotes:
    - name: zephyrproject-rtos
      url-base: https://github.com/zephyrproject-rtos
    - name: zmkfirmware
      url-base: https://github.com/zmkfirmware
    - name: nickconway
      url-base: https://github.com/nickconway
  projects:
    - name: zephyr
      remote: nickconway
      revision: nick3.0
      clone-depth: 1
      import:
        # TODO: Rename once upstream offers option like `exclude` or `denylist`
        name-blacklist:
          - ci-tools
          - hal_altera
          - hal_cypress
          - hal_infineon
          - hal_microchip
          - hal_nxp
          - hal_openisa
          - hal_silabs
          - hal_xtensa
          - hal_st
          - hal_ti
          - loramac-node
          - mcuboot
          - mcumgr
          - net-tools
          - openthread
          - edtt
          - trusted-firmware-m
          - sof
  self:
    west-commands: scripts/west-commands.yml
```
